## config/boards/shields/ksn_2/Kconfig.defconfig
```kconfig
if SHIELD_KSN_2_LEFT || SHIELD_KSN_2_RIGHT

config ZMK_KEYBOARD_NAME
    default "KSN2"

config ZMK_SPLIT
    default y

endif
```

## config/boards/shields/ksn_2/Kconfig.shield
```kconfig
config SHIELD_KSN_2_LEFT
    def_bool $(shields_list_contains,ksn_2_left)

config SHIELD_KSN_2_RIGHT
    def_bool $(shields_list_contains,ksn_2_right)
```
